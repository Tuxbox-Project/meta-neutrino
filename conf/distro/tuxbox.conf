## conf/distro/tuxbox.conf
```bitbake
# This is the tuxbox-neutrino build based on yocto poky

DISTRO_VERSION = "zeus"
DISTRO_VERSION_NUMBER = "${DISTRO_VERSION_NUMBER_MAJOR}.${DISTRO_VERSION_NUMBER_MINOR}.${DISTRO_VERSION_NUMBER_MICRO}"
DISTRO_VERSION_NUMBER_MAJOR = "3"
DISTRO_VERSION_NUMBER_MINOR = "0"
DISTRO_VERSION_NUMBER_MICRO = "3"
SDK_NAME = "tuxbox"
SDK_VERSION = "${DISTRO_VERSION}"

TCLIBC ?= "glibc"
TCLIBCAPPEND ?= ""
TMPDIR .= "${TCLIBCAPPEND}"
TMPDIR = "${TOPDIR}/tmp"

QA_LOGFILE = "${TMPDIR}/qa.log"

OEINCLUDELOGS ?= "yes"
PATCHRESOLVE = "noop"

PRSERV_HOST = "localhost:0"
RELEASE_STATE ?= "0"
UPDATE_SERVER_URL ?= ""
IMAGE_LOCATION ?= "file:////media/sda1/service/images"


KERNEL_CONSOLE ?= "ttyS0"
KEEPUIMAGE ??= "yes"

IMAGE_LINGUAS ?= "en-us de-de fr-fr"
ENABLE_BINARY_LOCALE_GENERATION ?= "1"
LOCALE_UTF8_IS_DEFAULT ?= "1"
LOCALE_UTF8_ONLY ?= "0"
LOCALE_UTF8_IS_DEFAULT_class-nativesdk = "0"

SSTATE_DIR = "${TOPDIR}/sstate-cache"
BB_GENERATE_MIRROR_TARBALLS ??= "0"
BBINCLUDELOGS ??= "yes"
BB_STRICT_CHECKSUM = "1"
NO32LIBS ??= "1"

USER_CLASSES ?= "buildstats image-mklibs image-prelink"

DISTRO_FEATURES_DEFAULT ?= "acl alsa argp bluetooth ext2 irda largefile pam systemd usbgadget usbhost wifi xattr nfs zeroconf nfc"
DISTRO_FEATURES_LIBC_DEFAULT ?= "ipv4 ipv6 libc-backtrace libc-big-macros libc-bsd libc-cxx-tests libc-catgets libc-charsets libc-crypt \
					libc-crypt-ufc libc-db-aliases libc-envz libc-fcvt libc-fmtmsg libc-fstab libc-ftraverse \
					libc-getlogin libc-idn libc-inet-anl libc-libm libc-locales libc-locale-code \
					libc-memusage libc-nis libc-nsswitch libc-rcmd libc-rtld-debug libc-spawn libc-streams libc-sunrpc \
					libc-utmp libc-utmpx libc-wordexp libc-posix-clang-wchar libc-posix-regexp libc-posix-regexp-glibc \
					libc-posix-wchar-io"
DISTRO_FEATURES_LIBC ?= "${DISTRO_FEATURES_LIBC_DEFAULT}"
DISTRO_FEATURES_LIBC_class-nativesdk = "${DISTRO_FEATURES_LIBC_DEFAULT}"
DISTRO_FEATURES ?= "${DISTRO_FEATURES_DEFAULT} ${DISTRO_FEATURES_LIBC}"
USE_NONFREE ?="yes"
IMAGE_FEATURES ?= ""
EXTRA_IMAGE_FEATURES = "debug-tweaks package-management"

require conf/distro/include/yocto-uninative.inc
INHERIT += "uninative"

WHITELIST_GPL-3.0 ?= ""
LGPLv2_WHITELIST_GPL-3.0 ?= ""

COMMERCIAL_AUDIO_PLUGINS ?= ""
# COMMERCIAL_AUDIO_PLUGINS ?= "gst-plugins-ugly-mad gst-plugins-ugly-mpegaudioparse"
COMMERCIAL_VIDEO_PLUGINS ?= ""
# COMMERCIAL_VIDEO_PLUGINS ?= "gst-plugins-ugly-mpeg2dec gst-plugins-ugly-mpegstream gst-plugins-bad-mpegvideoparse"
# Set of common licenses used for license.bbclass
COMMON_LICENSE_DIR ??= "${COREBASE}/meta/files/common-licenses"

# Allow java, svn and unzip executed on host
HOSTTOOLS += "svn unzip xmlcatalog"

DISTRO_FEATURES_append = " systemd"
DISTRO_FEATURES_BACKFILL_CONSIDERED += "sysvinit pulseaudio"
VIRTUAL-RUNTIME_init_manager = "systemd"
VIRTUAL-RUNTIME_initscripts = "systemd-compat-units"
VIRTUAL-RUNTIME_login_manager = "shadow-base"
MACHINE_FEATURES_BACKFILL_CONSIDERED = "rtc"

LICENSE_FLAGS_WHITELIST="commercial"

PREFERRED_VERSION_ffmpeg = "4.2.1"
PREFERRED_VERSION_webmin = "1.941"

SANITY_TESTED_DISTROS ?= " \
	poky-2.3-snapshot-20170912 \n \
	poky-2.6 \n \
	poky-2.7 \n \
	ubuntu-16.04 \n \
	ubuntu-18.04 \n \
	ubuntu-19.04 \n \
	ubuntu-19.10 \n \
	ubuntu-20.04 \n \
	fedora-28 \n \
	fedora-29 \n \
	fedora-30 \n \
	centos-7 \n \
	debian-8 \n \
	debian-9 \n \
	debian-10 \n \
	opensuseleap-15.1 \n \
"
```
